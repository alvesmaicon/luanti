## goodluckos/buildroot/Config.in
```kconfig
menu "Luanti app"
source "$BR2_EXTERNAL_LUANTI_PATH/package/luanti-libzip/Config.in"
source "$BR2_EXTERNAL_LUANTI_PATH/package/luanti/Config.in"
source "$BR2_EXTERNAL_LUANTI_PATH/package/luanti-game/Config.in"
endmenu
```

## goodluckos/buildroot/package/luanti-game/Config.in
```kconfig
config BR2_PACKAGE_LUANTI_GAME
	bool "luanti-game"
	depends on BR2_PACKAGE_LUANTI
	help
	  Minetest Game for Luanti, with Mobs Redo and its farm animals
	  (cows, sheep, chickens...) built into the game.

	  https://github.com/luanti-org/minetest_game
	  https://codeberg.org/tenplus1/mobs_animal
```

## goodluckos/buildroot/package/luanti-libzip/Config.in
```kconfig
config BR2_PACKAGE_LUANTI_LIBZIP
	bool
	select BR2_PACKAGE_ZLIB
	help
	  libzip for Luanti, a static library with zlib only.

	  https://libzip.org
```

## goodluckos/buildroot/package/luanti/Config.in
```kconfig
config BR2_PACKAGE_LUANTI
	bool "luanti"
	depends on BR2_INSTALL_LIBSTDCPP
	depends on BR2_TOOLCHAIN_HAS_THREADS_NPTL # openal
	depends on BR2_TOOLCHAIN_GCC_AT_LEAST_9 # C++17
	depends on !BR2_STATIC_LIBS
	depends on BR2_PACKAGE_HAS_LIBGLES
	depends on BR2_PACKAGE_OPENAL_ARCH_SUPPORTS
	select BR2_PACKAGE_FREETYPE
	select BR2_PACKAGE_JPEG
	select BR2_PACKAGE_JSONCPP
	select BR2_PACKAGE_LUANTI_LIBZIP
	select BR2_PACKAGE_LIBPNG
	select BR2_PACKAGE_LIBVORBIS
	select BR2_PACKAGE_OPENAL
	select BR2_PACKAGE_SDL2
	select BR2_PACKAGE_SQLITE
	select BR2_PACKAGE_ZLIB
	select BR2_PACKAGE_ZSTD
	help
	  This checkout's Luanti, built for goodluckOS's Luanti app. Client only,
	  OpenGL ES 2 through SDL2 (KMS/DRM). Uses LuaJIT when it is
	  enabled (Buildroot builds it only on an x86 host), otherwise
	  the bundled Lua 5.1.

	  https://www.luanti.org

comment "luanti needs a toolchain w/ C++, NPTL, gcc >= 9, dynamic library, and a GLES provider"
	depends on BR2_PACKAGE_OPENAL_ARCH_SUPPORTS
	depends on !BR2_INSTALL_LIBSTDCPP || !BR2_TOOLCHAIN_HAS_THREADS_NPTL || \
		!BR2_TOOLCHAIN_GCC_AT_LEAST_9 || BR2_STATIC_LIBS || \
		!BR2_PACKAGE_HAS_LIBGLES
```
